## drivers/hid/i2c-hid/Kconfig
```kconfig
menu "I2C HID support"
	depends on I2C

config I2C_HID
	tristate "HID over I2C transport layer"
	default n
	depends on I2C && INPUT
	select HID
	---help---
	  Say Y here if you use a keyboard, a touchpad, a touchscreen, or any
	  other HID based devices which is connected to your computer via I2C.

	  If unsure, say N.

	  This support is also available as a module.  If so, the module
	  will be called i2c-hid.

config I2C_HIDHW
	tristate "HID over I2C transport layer"
	depends on INPUT
	select HID
	---help---
	  Say Y here if you use a I2C STM sensor hub on BYT-M board.

	  If unsure, say N.

endmenu
```

## drivers/iio/pressure/Kconfig
```kconfig
#
# Pressure drivers
#
# When adding new entries keep the list in alphabetical order

menu "Pressure sensors"

config HID_SENSOR_PRESS
	depends on HID_SENSOR_HUB
	select IIO_BUFFER
	select IIO_TRIGGERED_BUFFER
	select HID_SENSOR_IIO_COMMON
	select HID_SENSOR_IIO_TRIGGER
	tristate "HID PRESS"
	help
	  Say yes here to build support for the HID SENSOR
	  Pressure driver

endmenu
```

## drivers/net/wireless/wl/Kconfig
```kconfig
config WL
	tristate "Broadcom 802.11a/b/g/n hybrid device driver"
	depends on PCI && CFG80211
	select WIRELESS_EXT
	select WEXT_PRIV
	select MAC80211
	select LIB80211
	select LIB80211_CRYPT_WEP
	select LIB80211_CRYPT_TKIP
	select LIB80211_CRYPT_CCMP
	---help---
	  This module adds support for Broadcom 802.11a/b/g/n hybrid Networking Device Driver.

	  This driver can be built as a module (recommended) that will be called "wl".
	  If unsure, say M.
```
